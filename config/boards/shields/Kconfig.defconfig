## config/boards/shields/Kconfig.defconfig
```kconfig
if SHIELD_PORTEX_ORIGIN

config ZMK_KEYBOARD_NAME
    default"portex_origin"

endif
```

## config/boards/shields/portex_origin/Kconfig.shield
```kconfig
config SHIELD_PORTEX_ORIGIN
    def_bool $(shields_list_contains, portex_origin)
```
